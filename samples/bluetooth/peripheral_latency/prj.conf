## CMakeLists.txt
```
#
# Copyright (c) 2024 Nordic Semiconductor
#
# SPDX-License-Identifier: LicenseRef-Nordic-5-Clause
#

cmake_minimum_required(VERSION 3.20.0)

find_package(Zephyr REQUIRED HINTS $ENV{ZEPHYR_BASE})
project(bluetooth_peripheral_latency)

# NORDIC SDK APP START
target_sources(app PRIVATE
  src/main.c
)
# NORDIC SDK APP END
```

## sample.yaml
```
sample:
  description: Minimal low-power connectable peripheral for latency / subrating
    power measurement
  name: Bluetooth LE Peripheral Latency

common:
  sysbuild: true
  build_only: true
  tags:
    - bluetooth
    - ci_build
    - sysbuild
    - ci_samples_bluetooth

tests:
  sample.bluetooth.peripheral_latency:
    platform_allow:
      - nrf52dk/nrf52832
      - nrf52840dk/nrf52840
      - nrf5340dk/nrf5340/cpuapp
      - nrf5340dk/nrf5340/cpuapp/ns
      - nrf54l15dk/nrf54l15/cpuapp
      - nrf54lm20dk/nrf54lm20a/cpuapp
      - nrf54lm20dk/nrf54lm20b/cpuapp
    integration_platforms:
      - nrf52840dk/nrf52840
      - nrf5340dk/nrf5340/cpuapp
      - nrf54l15dk/nrf54l15/cpuapp
      - nrf54lm20dk/nrf54lm20b/cpuapp
```

## prj.conf
```kconfig
#
# Copyright (c) 2024 Nordic Semiconductor
#
# SPDX-License-Identifier: LicenseRef-Nordic-5-Clause
#
# Minimal low-power connectable peripheral for manual subrating / peripheral
# latency power measurements. UART, serial, logging and other power-drawing
# peripherals are disabled. The peer (central) drives connection setup,
# peripheral latency and subrating. The link is encrypted automatically.

CONFIG_NCS_SAMPLES_DEFAULTS=y

CONFIG_BT=y
CONFIG_BT_PERIPHERAL=y
CONFIG_BT_SMP=y
CONFIG_BT_BONDABLE=n
CONFIG_BT_DEVICE_NAME="nordic_latency_test"
CONFIG_BT_MAX_CONN=1
CONFIG_BT_SUBRATING=y

# Do not auto-run host procedures; connection/subrating is driven externally
CONFIG_BT_GAP_AUTO_UPDATE_CONN_PARAMS=n
CONFIG_BT_AUTO_PHY_PERIPHERAL_NONE=y
CONFIG_BT_AUTO_DATA_LEN_UPDATE=n

CONFIG_BT_NUS=n
CONFIG_BT_SETTINGS=n
CONFIG_SETTINGS=n
CONFIG_FLASH=n
CONFIG_FLASH_PAGE_LAYOUT=n
CONFIG_FLASH_MAP=n

CONFIG_DK_LIBRARY=n

# SMP/ECC (LE Secure Connections) needs heap for the PSA crypto backend.
CONFIG_HEAP_MEM_POOL_SIZE=2048

# Drivers and peripherals
CONFIG_I2C=n
CONFIG_WATCHDOG=n
CONFIG_SPI=n
CONFIG_GPIO=n
CONFIG_SERIAL=n
CONFIG_UART_ASYNC_API=n
CONFIG_NRFX_UARTE=n

# Power / boot
CONFIG_NCS_BOOT_BANNER=n
CONFIG_BOOT_BANNER=n
CONFIG_BOOT_DELAY=0

# Console / logging
CONFIG_CONSOLE=n
CONFIG_UART_CONSOLE=n
CONFIG_STDOUT_CONSOLE=n
CONFIG_PRINTK=n
CONFIG_EARLY_CONSOLE=n
CONFIG_LOG=n
CONFIG_USE_SEGGER_RTT=n
CONFIG_LOG_BACKEND_RTT=n

# Build
CONFIG_SIZE_OPTIMIZATIONS=y

# ARM
CONFIG_ARM_MPU=n

# Disable features not needed
CONFIG_TIMESLICING=n
CONFIG_ASSERT=n

# Disable Bluetooth features not needed
CONFIG_BT_DEBUG_NONE=y
CONFIG_BT_ASSERT=n
CONFIG_BT_DATA_LEN_UPDATE=n
CONFIG_BT_PHY_UPDATE=n
CONFIG_BT_GATT_CACHING=n
CONFIG_BT_GATT_SERVICE_CHANGED=n
CONFIG_BT_GAP_PERIPHERAL_PREF_PARAMS=n
CONFIG_BT_HCI_VS=n
```

## src/main.c
```c
/*
 * Copyright (c) 2024 Nordic Semiconductor ASA
 *
 * SPDX-License-Identifier: LicenseRef-Nordic-5-Clause
 */

/** @file
 *  @brief Minimal low-power connectable BLE peripheral.
 *
 *  Advertises connectably and keeps the link up with no application-level
 *  data. No UART, NUS, logging, or DK peripherals. Connection parameters,
 *  peripheral latency and subrating are driven by the peer (central). The
 *  link is encrypted automatically (Just Works, no bonding).
 */

#include <zephyr/kernel.h>
#include <zephyr/bluetooth/bluetooth.h>
#include <zephyr/bluetooth/conn.h>
#include <zephyr/bluetooth/gap.h>
#include <zephyr/bluetooth/hci.h>

#define DEVICE_NAME     CONFIG_BT_DEVICE_NAME
#define DEVICE_NAME_LEN (sizeof(DEVICE_NAME) - 1)

static struct k_work adv_work;

static const struct bt_data ad[] = {
	BT_DATA_BYTES(BT_DATA_FLAGS, (BT_LE_AD_GENERAL | BT_LE_AD_NO_BREDR)),
	BT_DATA(BT_DATA_NAME_COMPLETE, DEVICE_NAME, DEVICE_NAME_LEN),
};

static void adv_work_handler(struct k_work *work)
{
	ARG_UNUSED(work);

	(void)bt_le_adv_start(BT_LE_ADV_CONN_FAST_2, ad, ARRAY_SIZE(ad), NULL, 0);
}

static void advertising_start(void)
{
	k_work_submit(&adv_work);
}

#if defined(CONFIG_BT_SMP)
static void pairing_confirm(struct bt_conn *conn)
{
	(void)bt_conn_auth_pairing_confirm(conn);
}

static void auth_cancel(struct bt_conn *conn)
{
	ARG_UNUSED(conn);
}

/* The cancel callback is mandatory when any interactive auth callback
 * (here, pairing_confirm) is provided; otherwise bt_conn_auth_cb_register()
 * returns -EINVAL.
 */
static struct bt_conn_auth_cb auth_cb = {
	.pairing_confirm = pairing_confirm,
	.cancel = auth_cancel,
};

static void security_changed(struct bt_conn *conn, bt_security_t level,
			     enum bt_security_err err)
{
	ARG_UNUSED(level);

	if (err) {
		bt_conn_disconnect(conn, BT_HCI_ERR_AUTH_FAIL);
	}
}
#endif /* CONFIG_BT_SMP */

static void connected(struct bt_conn *conn, uint8_t err)
{
	if (err) {
		advertising_start();
		return;
	}

#if defined(CONFIG_BT_SMP)
	(void)bt_conn_set_security(conn, BT_SECURITY_L2);
#endif
}

static void disconnected(struct bt_conn *conn, uint8_t reason)
{
	ARG_UNUSED(conn);
	ARG_UNUSED(reason);
}

static void recycled_cb(void)
{
	advertising_start();
}

BT_CONN_CB_DEFINE(conn_callbacks) = {
	.connected = connected,
	.disconnected = disconnected,
	.recycled = recycled_cb,
#if defined(CONFIG_BT_SMP)
	.security_changed = security_changed,
#endif
};

int main(void)
{
	int err;

#if defined(CONFIG_BT_SMP)
	err = bt_conn_auth_cb_register(&auth_cb);
	if (err) {
		return 0;
	}
#endif

	err = bt_enable(NULL);
	if (err) {
		return 0;
	}

	k_work_init(&adv_work, adv_work_handler);
	advertising_start();

	for (;;) {
		k_sleep(K_FOREVER);
	}
}
```
